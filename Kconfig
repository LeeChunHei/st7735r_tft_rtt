## Kconfig
```kconfig
# Kconfig file for package st7735r_tft
menuconfig PKG_USING_ST7735R_TFT
    bool "st7735r tft lcd driver package"
    default n

if PKG_USING_ST7735R_TFT

    config PKG_ST7735R_TFT_PATH
        string
        default "/packages/peripherals/st7735r_tft"

    choice
        prompt "Version"
        default PKG_USING_ST7735R_TFT_LATEST_VERSION
        help
            Select the package version

        config PKG_USING_ST7735R_TFT_V100
            bool "v1.0.0"

        config PKG_USING_ST7735R_TFT_LATEST_VERSION
            bool "latest"
    endchoice
          
    config PKG_ST7735R_TFT_VER
       string
       default "v1.0.0"    if PKG_USING_ST7735R_TFT_V100
       default "latest"    if PKG_USING_ST7735R_TFT_LATEST_VERSION

    config PKG_ST7735R_USING_KCONFIG
        bool "Setup st7735r tft in menuconfig"
        default n
    
    if PKG_ST7735R_USING_KCONFIG
        config PKG_ST7735R_SPI_BUS
            string "SPI bus connected to the tft lcd"
            default "spi0"

        config PKG_ST7735R_CS_GPIO
            int "GPIO port number for the chip select pin"
            help
                The cs pin is (pin number) of pin in the (port number) of GPIO port
        config PKG_ST7735R_CS_PIN
            int "GPIO pin number for the chip select pin"
            help
                The cs pin is (pin number) of pin in the (port number) of GPIO port

        config PKG_ST7735R_ADJ_BL
            bool "Adjustable backlight"
            default n

        if PKG_ST7735R_ADJ_BL
            config PKG_ST7735R_BL_PWM
                string "Backlight pwm name"
            config PKG_ST7735R_BL_PWM_CHANNEL
                int "Backlight pwm channel"
            config PKG_ST7735R_BL_PWM_FREQ
                int "Backlight frequency (Hz)"
                default 50000
            config PKG_ST7735R_BL_DEFAULT_INTENSITY
                int "Backlight default intensity"
                range 0 100
                default 50
        endif

        config PKG_ST7735R_BL_GPIO
            int "GPIO port number for the backlight pin"
            help
                The bl pin is (pin number) of pin in the (port number) of GPIO port
        config PKG_ST7735R_BL_PIN
            int "GPIO pin number for the backlight pin"
            help
                The bl pin is (pin number) of pin in the (port number) of GPIO port

        config PKG_ST7735R_DC_GPIO
            int "GPIO port number for the dc pin"
            help
                The dc pin is (pin number) of pin in the (port number) of GPIO port
        config PKG_ST7735R_DC_PIN
            int "GPIO pin number for the dc pin"
            help
                The dc pin is (pin number) of pin in the (port number) of GPIO port

        config PKG_ST7735R_RES_GPIO
            int "GPIO port number for the reset pin"
            help
                The res pin is (pin number) of pin in the (port number) of GPIO port
        config PKG_ST7735R_RES_PIN
            int "GPIO pin number for the reset pin"
            help
                The res pin is (pin number) of pin in the (port number) of GPIO port
        
        config PKG_ST7735R_WIDTH
            int "Width of the tft lcd"
            default 128
            
        config PKG_ST7735R_HEIGHT
            int "Height of the tft lcd"
            default 160
    endif

endif
```
